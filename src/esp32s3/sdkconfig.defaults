## src/esp32s3/sdkconfig.defaults
```kconfig
# ESP32-S3 CPU & memory configuration
CONFIG_IDF_TARGET="esp32s3"
CONFIG_ESP32S3_DEFAULT_CPU_FREQ_240=y
CONFIG_ESP32S3_DEFAULT_CPU_FREQ_MHZ=240

# OPI PSRAM – ESP32-S3R8 has 8 MB Octal PSRAM built into the package.
# Must use OCT mode (not QIO); 80 MHz for stability.
# IGNORE_NOTFOUND=y: log a warning and continue if PSRAM init fails, so the
# console output is visible even if the config is wrong.
CONFIG_SPIRAM=y
CONFIG_SPIRAM_MODE_OCT=y
CONFIG_SPIRAM_SPEED_80M=y
CONFIG_SPIRAM_TYPE_AUTO=y
CONFIG_SPIRAM_IGNORE_NOTFOUND=y
# Allow large heap allocations (PRG/CHR copies) to use PSRAM, keeping
# critical internal SRAM free for DMA buffers and hot data.
# Allocations < 8 KB stay in internal SRAM (stacks, small structs, etc.).
# Reserve only 8 KB of internal SRAM for DMA (down from the default 32 KB).
# This frees ~24 KB so the 32 KB PRG ROM copy can land in internal SRAM
# for zero-wait-state 6502 instruction fetches.
CONFIG_SPIRAM_MALLOC_RESERVE_INTERNAL=8192
CONFIG_SPIRAM_USE_MALLOC=y
CONFIG_SPIRAM_MALLOC_ALWAYSINTERNAL=8192
# Do not relocate code or rodata to PSRAM – they stay in flash/IRAM.
CONFIG_SPIRAM_FETCH_INSTRUCTIONS=n
CONFIG_SPIRAM_RODATA=n

# Flash (16MB)
CONFIG_ESPTOOLPY_FLASHSIZE_16MB=y
CONFIG_ESPTOOLPY_FLASHSIZE="16MB"
CONFIG_ESPTOOLPY_FLASHMODE_QIO=y
CONFIG_ESPTOOLPY_FLASHMODE="qio"
CONFIG_PARTITION_TABLE_CUSTOM=y
CONFIG_PARTITION_TABLE_CUSTOM_FILENAME="partitions.csv"

# Cache
CONFIG_ESP32S3_INSTRUCTION_CACHE_32KB=y
CONFIG_ESP32S3_INSTRUCTION_CACHE_SIZE=0x8000
CONFIG_ESP32S3_INSTRUCTION_CACHE_8WAYS=y
CONFIG_ESP32S3_INSTRUCTION_CACHE_LINE_32B=y
CONFIG_ESP32S3_DATA_CACHE_64KB=y
CONFIG_ESP32S3_DATA_CACHE_SIZE=0x10000
CONFIG_ESP32S3_DATA_CACHE_8WAYS=y
CONFIG_ESP32S3_DATA_CACHE_LINE_32B=y

# Use the ESP32-S3 hardware USB Serial/JTAG peripheral for the console.
# This is built into silicon – it works from the first ROM boot message,
# requires no firmware initialisation, and does not fight with macOS over
# CDC control signals (which caused boot:0x2 / download-mode loops).
CONFIG_ESP_CONSOLE_USB_SERIAL_JTAG=y
CONFIG_ESP_CONSOLE_SECONDARY_NONE=y

# Logging
CONFIG_LOG_DEFAULT_LEVEL_INFO=y

# FreeRTOS tick rate (1kHz for sub-ms timing)
CONFIG_FREERTOS_HZ=1000

# Increase main task stack (NES struct is large)
CONFIG_ESP_MAIN_TASK_STACK_SIZE=8192

# Watchdog – disable task watchdog to avoid false triggers during frame step
CONFIG_ESP_TASK_WDT_EN=n

# SPI DMA buffer alignment
CONFIG_SPI_MASTER_IN_IRAM=y

# Compiler optimizations for performance
CONFIG_COMPILER_OPTIMIZATION_PERF=y
CONFIG_COMPILER_OPTIMIZATION_ASSERTIONS_DISABLE=y
```
